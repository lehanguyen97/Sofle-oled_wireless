## Kconfig
```kconfig
config ZMK_DEFAULT_LAYER
    bool "Persistent default layer selection per endpoint"

if ZMK_DEFAULT_LAYER

config ZMK_DEFAULT_LAYER_MIN_INDEX
    int "Minimum layer index configurable as default layer"
    default 0

config ZMK_DEFAULT_LAYER_MAX_INDEX
    int "Maximum layer index configurable as default layer"
    default 1

endif # ZMK_DEFAULT_LAYER

config ZMK_SPLIT_SLEEP_HEARTBEAT
    bool "Best-effort central-to-peripheral sleep heartbeat"
    depends on ZMK_SPLIT

if ZMK_SPLIT_SLEEP_HEARTBEAT

config ZMK_SPLIT_SLEEP_HEARTBEAT_INTERVAL_MS
    int "Central heartbeat interval in milliseconds"
    default 10000

endif # ZMK_SPLIT_SLEEP_HEARTBEAT
```

## dts/bindings/behaviors/zmk,behavior-actping.yaml
```yaml
# Copyright (c) 2026 The ZMK Contributors
# SPDX-License-Identifier: MIT

description: Split sleep heartbeat ping behavior

compatible: "zmk,behavior-actping"

include: zero_param.yaml
```

## dts/bindings/behaviors/zmk,behavior-default-layer.yaml
```yaml
# Copyright (c) 2024 The ZMK Contributors
# SPDX-License-Identifier: MIT

description: Default layer behavior

compatible: "zmk,behavior-default-layer"

include: two_param.yaml
```
